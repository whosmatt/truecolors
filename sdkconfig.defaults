## sdkconfig.defaults
```kconfig
# Common defaults

# --- Flash & partition table ---------------------------------------------
# Board has 16 MB physically, but we target an 8 MB image so it stays portable
# across both the 8 MB and 16 MB parts.
CONFIG_ESPTOOLPY_FLASHSIZE_8MB=y
CONFIG_PARTITION_TABLE_CUSTOM=y
CONFIG_PARTITION_TABLE_CUSTOM_FILENAME="partitions.csv"

# --- OTA rollback --------------------------------------------------------
# A freshly OTA'd image boots in PENDING_VERIFY; if it doesn't confirm itself
# (esp_ota_mark_app_valid_cancel_rollback in app_main on boot success) before
# the next reset, the bootloader rolls back to the previous working image.
CONFIG_BOOTLOADER_APP_ROLLBACK_ENABLE=y

# --- Console: native USB-Serial-JTAG (GPIO19/20) -------------------------
# The board flashes/monitors over the native USB port (no external probe).
CONFIG_ESP_CONSOLE_USB_SERIAL_JTAG=y

# --- HTTP server: WebSocket support (realtime transport) -----------------
CONFIG_HTTPD_WS_SUPPORT=y

# --- lwIP: enough sockets for the WS client pool plus httpd internals ----
CONFIG_LWIP_MAX_SOCKETS=16

# --- FreeRTOS ------------------------------------------------------------
# 1 kHz tick so the render task and animation engine get fine-grained delays.
CONFIG_FREERTOS_HZ=1000

# --- Interrupt watchdog --------------------------------------------------
# 800ms WDT to give wifi a bit more breathing room
CONFIG_ESP_INT_WDT_TIMEOUT_MS=800
```

## sdkconfig.defaults.esp32s3
```kconfig
# ESP32-S3-WROOM-1 (N8R8) target defaults.

# --- Octal PSRAM (8 MB) --------------------------------------------------
# Octal PSRAM consumes GPIO35/36/37 — do not use those as I/O.
CONFIG_SPIRAM=y
CONFIG_SPIRAM_MODE_OCT=y
CONFIG_SPIRAM_SPEED_80M=y
# Boot even if PSRAM is absent (e.g. under QEMU) instead of aborting.
CONFIG_SPIRAM_IGNORE_NOTFOUND=y

# --- CPU -----------------------------------------------------------------
CONFIG_ESP_DEFAULT_CPU_FREQ_MHZ_240=y

# --- Flash mode (octal-capable part; QIO/80 MHz is safe and portable) ----
CONFIG_ESPTOOLPY_FLASHMODE_QIO=y
CONFIG_ESPTOOLPY_FLASHFREQ_80M=y
```
