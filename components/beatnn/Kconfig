## components/beatnn/Kconfig
```kconfig
menu "Beat model"

config BEATNN_ARENA_KB
    int "TFLM tensor arena per stage (KB)"
    default 5
    help
        Arena *per* stage, reserved statically in .bss for alignment
        beatnn_arena_used() reports footprint

endmenu
```
